## Kconfig
```kconfig
# Copyright (c) 2024 Goodix
# SPDX-License-Identifier: Apache-2.0

rsource "drivers/Kconfig"
rsource "ble_sdk/gr5525/Kconfig"
```

## ble_sdk/gr5525/Kconfig
```kconfig
# Copyright (c) 2024 Goodix
# SPDX-License-Identifier: Apache-2.0

if SOC_GR5525

menu "GR5525 Components"

config GOODIX_OPT_MBEDTLS_LIB
    bool "Enable Goodix opt mbedTLS library"
    help
      This option enables the mbedTLS cryptography library.

config GOODIX_HW_SE_LIB
    bool "Enable GR55xx SE library"
    help
      This option enables GR55xx Hardware SE library.

config GOODIX_APP_MEMORY_LIB
    bool "Enable GR55xx app memory library"
    help
      This option enables GR55xx app memory library.

endmenu

endif # SOC_GR5525
```

## boards/goodix/gr5525_sk/Kconfig.gr5525_sk
```kconfig
# Copyright (c) 2024 Goodix
# SPDX-License-Identifier: Apache-2.0

config BOARD_GR5525_SK
    select SOC_GR5525
```

## boards/goodix/gr5525_sk/board.yml
```yaml
# Copyright (c) 2024 Goodix
# SPDX-License-Identifier: Apache-2.0

board:
  name: gr5525_sk
  vendor: goodix
  socs:
    - name: gr5525
```

## boards/goodix/gr5525_sk/gr5525_sk_defconfig
```kconfig
# Copyright (c) 2024 Goodix
# SPDX-License-Identifier: Apache-2.0

CONFIG_CONSOLE=y
CONFIG_PRINTK=y
CONFIG_UART_CONSOLE=y
CONFIG_UART_INTERRUPT_DRIVEN=y
# CONFIG_PM=y
# CONFIG_PM_DEVICE=y
```

## drivers/Kconfig
```kconfig
# Copyright (c) 2024 Goodix
# SPDX-License-Identifier: Apache-2.0

menu "Device Drivers"

# zephyr-keep-sorted-start
rsource "adc/Kconfig"
rsource "bluetooth/Kconfig"
rsource "flash/Kconfig"
rsource "gpio/Kconfig"
rsource "i2c/Kconfig"
rsource "pinctrl/Kconfig"
rsource "pwm/Kconfig"
rsource "serial/Kconfig"
rsource "trng/Kconfig"
rsource "timer/Kconfig"
# zephyr-keep-sorted-stop

endmenu
```

## drivers/adc/Kconfig
```kconfig
# Copyright (c) 2024 Goodix
# SPDX-License-Identifier: Apache-2.0

if ADC

rsource "Kconfig.gr5xxx"

endif # ADC
```

## drivers/adc/Kconfig.gr5xxx
```kconfig
# Copyright (c) 2024 Goodix
# SPDX-License-Identifier: Apache-2.0

config ADC_GR5XXX
    bool "GR5xxx ADC driver"
    default y
    select ADC_CONFIGURABLE_INPUTS
    depends on DT_HAS_GOODIX_GR5XXX_ADC_ENABLED

config ADC_GR5XXX_IGNORE_UNSUPPORTED_PARAMETERS
    bool "Ignore unsupported channel_cfg parameters"
    default y
    depends on ADC_GR5XXX
    help
      Indicates whether to ignore unsupported channel_cfg parameters in setup channel function.

config ADC_GR5XXX_ADC_CHANNEL_COUNT
    int "Number of ADC channels"
    range 1 32
    default 1
    depends on ADC_GR5XXX
    help
      Number of ADC channels to be supported by the driver. Each channel
      needs a dedicated structure in RAM that stores the ADC settings
      to be used when sampling this channel.

config ADC_GR5XXX_MAX_OVERSAMPLING_EXP
    int "Maximum oversampling exponent"
    range 0 7
    default 7
    depends on ADC_GR5XXX
    help
      Maximum `oversampling` parameter that can be passed in struct adc_sequence.
      Oversampling is done in software.

config ADC_GR5XXX_SUPPORT_ZEPHYR_CONVERT
    bool "Support adc_raw_to_millivolts implemented by zephyr"
    default y
    depends on ADC_GR5XXX
    help
      Whether to support adc_raw_to_millivolts() conversion. If disabled,
      please use gdx_adc_raw_to_voltage() function for converting ADC raw
      value to real voltage
```

## drivers/bluetooth/Kconfig
```kconfig
# Copyright (c) 2024 Goodix
# SPDX-License-Identifier: Apache-2.0

if BT_HCI

config BT_HCI_RESERVE
    int
    default 0 if BT_H4
    default 1 if BT_H5
    # Even if no driver is selected the following default is still
    # needed e.g. for unit tests.
    default 1
    help
      Headroom that the driver needs for sending and receiving buffers. Add a
      new 'default' entry for each new driver.

rsource "hci/Kconfig"

endif
```

## drivers/bluetooth/hci/Kconfig
```kconfig
# Copyright (c) 2024 Goodix
# SPDX-License-Identifier: Apache-2.0

choice BT_HCI_BUS_TYPE
	prompt "Bluetooth HCI driver"

config BT_GR5525
    bool "GR5525 HCI based driver"
    depends on SOC_SERIES_GR552X
    help
      This driver provides access to the GR5525's Bluetooth adapter. It
      is only intended to be used with the GR5525 build of Zephyr.


endchoice

if BT_GR5525

config BT_BUF_ACL_RX_SIZE
  default 251

endif # BT_GR5525
```

## drivers/flash/Kconfig
```kconfig
# Copyright (c) 2024 Goodix
# SPDX-License-Identifier: Apache-2.0

#
# Flash driver
#

if FLASH

rsource "Kconfig.gr5xxx"

endif # FLASH
```

## drivers/flash/Kconfig.gr5xxx
```kconfig
# Copyright (c) 2024 Goodix
# SPDX-License-Identifier: Apache-2.0

config SOC_FLASH_GR55XX
	bool "GR55XX SOC SiP Flash driver"
	default y
	depends on DT_HAS_GOODIX_GR5XXX_FLASH_CONTROLLER_ENABLED
	select FLASH_HAS_DRIVER_ENABLED
	select FLASH_JESD216
	select FLASH_PAGE_LAYOUT
	select FLASH_HAS_PAGE_LAYOUT
	help
	  Enable XQSPI-NOR support on the GR55XX SOCs.
```

## drivers/gpio/Kconfig
```kconfig
# Copyright (c) 2024 Goodix
# SPDX-License-Identifier: Apache-2.0

if GPIO

rsource "Kconfig.gr5xxx"

endif # GPIO
```

## drivers/gpio/Kconfig.gr5xxx
```kconfig
# Copyright (c) 2024 Goodix
# SPDX-License-Identifier: Apache-2.0

config GPIO_GR5XXX
    bool "GR5xxx GPIO/AONIO/MSIO driver"
    default y
    depends on DT_HAS_GOODIX_GR5XXX_GPIO_ENABLED
```

## drivers/i2c/Kconfig
```kconfig
# Copyright (c) 2024 Goodix
# SPDX-License-Identifier: Apache-2.0

if I2C

rsource "Kconfig.gr5xxx"

endif # I2C
```

## drivers/i2c/Kconfig.gr5xxx
```kconfig
# Copyright (c) 2024 Goodix
# SPDX-License-Identifier: Apache-2.0

config I2C_GR5XXX
    bool "GR5xxx I2C driver"
    default y
    depends on DT_HAS_GOODIX_GR5XXX_I2C_ENABLED
```

## drivers/pinctrl/Kconfig
```kconfig
# Copyright (c) 2024 Goodix
# SPDX-License-Identifier: Apache-2.0

if PINCTRL

rsource "Kconfig.gr5xxx"

endif # PINCTRL
```

## drivers/pinctrl/Kconfig.gr5xxx
```kconfig
# Copyright (c) 2024 Goodix
# SPDX-License-Identifier: Apache-2.0

config PINCTRL_GR5XXX
    bool "GR5xxx pin controller driver"
    default y
    depends on DT_HAS_GOODIX_GR5XXX_PINCTRL_ENABLED
    help
        GR5xxx pin controller driver
```

## drivers/pwm/Kconfig
```kconfig
# Copyright (c) 2024 Goodix
# SPDX-License-Identifier: Apache-2.0

if PWM

rsource "Kconfig.gr5xxx"

endif # PWM
```

## drivers/pwm/Kconfig.gr5xxx
```kconfig
# Copyright (c) 2024 Goodix
# SPDX-License-Identifier: Apache-2.0

config PWM_GR5XXX
    bool "GR5XXX PWM driver"
    default y
    depends on DT_HAS_GOODIX_GR5XXX_PWM_ENABLED
    help
        GR5XXX PWM driver
```

## drivers/serial/Kconfig
```kconfig
# Copyright (c) 2024 Goodix
# SPDX-License-Identifier: Apache-2.0

if SERIAL

rsource "Kconfig.gr5xxx"

endif # SERIAL
```

## drivers/serial/Kconfig.gr5xxx
```kconfig
# Copyright (c) 2024 Goodix
# SPDX-License-Identifier: Apache-2.0

config UART_GR5XXX
    bool "GR5xxx serial driver"
    default y
    depends on DT_HAS_GOODIX_GR5XXX_UART_ENABLED
    select SERIAL_HAS_DRIVER
    select SERIAL_SUPPORT_INTERRUPT
    select SERIAL_SUPPORT_ASYNC
    select DMA if UART_ASYNC_API
```

## drivers/timer/Kconfig
```kconfig
# Copyright (c) 2024 Goodix
# SPDX-License-Identifier: Apache-2.0

if SYS_CLOCK_EXISTS

menu "Timer drivers"

rsource "Kconfig.gr5xxx"

endmenu

endif # SYS_CLOCK_EXISTS
```

## drivers/timer/Kconfig.gr5xxx
```kconfig
# Copyright (c) 2024 Goodix
# SPDX-License-Identifier: Apache-2.0

config GR552X_RTC_TIMER
    bool "GR552X RTC timer support"
    default y
    depends on SOC_SERIES_GR552X && !DT_HAS_ARM_ARMV7M_SYSTICK_ENABLED
    select TICKLESS_CAPABLE
    help
      Enables the system timer driver for GR552X and provides the standard "system c lock driver" interface.
```
