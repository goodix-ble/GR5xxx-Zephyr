## drivers/trng/Kconfig
```kconfig
# Copyright (c) 2024 Goodix
# SPDX-License-Identifier: Apache-2.0

# rng driver configuration options

if ENTROPY_GENERATOR

rsource "Kconfig.gr5xxx"

endif # ENTROPY_GENERATOR
```

## drivers/trng/Kconfig.gr5xxx
```kconfig
# Copyright (c) 2024 Goodix
# SPDX-License-Identifier: Apache-2.0

config TRNG_GR5XXX
	bool "GR55XX SOC TRNG driver"
	default y
	depends on DT_HAS_GOODIX_GR5XXX_TRNG_ENABLED
	select ENTROPY_HAS_DRIVER
	help
	  Enable TRNG support on the GR55XX SOCs.
```

## dts/bindings/adc/goodix,gr5xxx-adc.yaml
```yaml
# Copyright (c) 2024 Goodix
# SPDX-License-Identifier: Apache-2.0

description: Goodix GR5xxx ADC node

compatible: "goodix,gr5xxx-adc"

include: [adc-controller.yaml, pinctrl-device.yaml]

properties:
  reg:
    required: true
  ref_voltage:
    required: true
    type: string
    description: |
      ADC reference value
    default: "1p6"
    enum:
      - "0p8"
      - "1p2"
      - "1p6"
  clock:
    required: true
    type: string
    description: |
      ADC clock
    default: "16M"
    enum:
      - "16M"
      - "8M"
      - "4M"
      - "1M"
      - "16K"
      - "8K"
      - "4K"

io-channel-cells:
  - input
```

## dts/bindings/flash_controller/goodix,gr5xxx-flash-controller.yaml
```yaml
# Copyright (c) 2024 Goodix
# SPDX-License-Identifier: Apache-2.0

description: Goodix GR5xxx flash-controller

compatible: "goodix,gr5xxx-flash-controller"

include: "flash-controller.yaml"

properties:
  partial-erase:
    type: boolean
    description: Indicates whether NVMC supports partial erase of flash pages
```

## dts/bindings/gpio/goodix,gr5xxx-gpio.yaml
```yaml
# Copyright (c) 2024 Goodix
# SPDX-License-Identifier: Apache-2.0

description: GR5xxx GPIO node

compatible: "goodix,gr5xxx-gpio"

include: [gpio-controller.yaml, base.yaml]

properties:
  reg:
    required: true

  interrupts:
    required: true

  "#gpio-cells":
    const: 2

gpio-cells:
  - pin
  - flags
```

## dts/bindings/gpio/goodix,gr5xxx-msio.yaml
```yaml
# Copyright (c) 2024 Goodix
# SPDX-License-Identifier: Apache-2.0

description: GR5xxx MSIO node

compatible: "goodix,gr5xxx-msio"

include: [gpio-controller.yaml, base.yaml]

properties:
  reg:
    required: true

  "#gpio-cells":
    const: 2

gpio-cells:
  - pin
  - flags
```

## dts/bindings/i2c/goodix,gr5xxx-i2c.yaml
```yaml
# Copyright (c) 2024 Goodix
# SPDX-License-Identifier: Apache-2.0

description: GR5XXX I2C

compatible: "goodix,gr5xxx-i2c"

include: [i2c-controller.yaml, pinctrl-device.yaml]

properties:
  reg:
    required: true

  interrupts:
    required: true

  pinctrl-0:
    required: true
```

## dts/bindings/pinctrl/goodix,gr5xxx-pinctrl.yaml
```yaml
# Copyright (c) 2024 Goodix
# SPDX-License-Identifier: Apache-2.0

description: |
  GR552x Pin Controller Node
  Based on pincfg-node.yaml binding.

compatible: "goodix,gr5xxx-pinctrl"

include:
  - base.yaml

child-binding:
  include:
    - name: "pincfg-node.yaml"
      property-allowlist:
        - bias-disbale
        - bias-pull-down
        - bias-pull-up
        - input-schmitt-enable
        - input-schmitt-disable

  properties:
    port:
      required: true
      type: string
      enum:
        - "gpioa"
        - "gpiob"
        - "gpioc"
        - "aon_gpio"
        - "msio"

    pin:
      required: true
      type: int

    mux:
      required: true
      type: int

    is_analog:
      type: boolean

    drive-strength:
      type: string
      enum:
        - "low"
        - "medium"
        - "high"
        - "ultra"
      default: "medium"
      description: |
        The drive strength of a pin, only works on GR5525
```

## dts/bindings/pwm/goodix,gr5xxx-pwm.yaml
```yaml
# Copyright (c) 2024 Goodix
# SPDX-License-Identifier: Apache-2.0

description: GR55XX PWM

compatible: "goodix,gr5xxx-pwm"

include: [base.yaml, pwm-controller.yaml, pinctrl-device.yaml]

properties:
    reg:
        required: true
    pinctrl-0:
        required: true
    pinctrl-names:
        required: true
    "#pwm-cells":
        const: 3

pwm-cells:
  - channel
  - period
  - flags
```

## dts/bindings/serial/goodix,gr5xxx-uart.yaml
```yaml
# Copyright (c) 2024 Goodix
# SPDX-License-Identifier: Apache-2.0

description: GR5XXX UART

compatible: "goodix,gr5xxx-uart"

include: [uart-controller.yaml, pinctrl-device.yaml]

properties:
  reg:
    required: true

  interrupts:
    required: true

  parity:
    required: false
    type: string
    description: |
      Configures the parity of the adapter. Enumeration id 0 for none, 1 for odd
      and 2 for even parity. Default to none if not specified.
    enum:
      - "none"
      - "odd"
      - "even"

  current-speed:
    type: int
    required: true
    description: Initial baud rate setting for UART

  pinctrl-0:
    type: phandles
    required: true
    description: |
      GPIO pin configuration for serial signals (RX, TX, RTS, CTS).  We expect
      that the phandles will reference pinctrl nodes.
      For example the USART1 would be
          pinctrl-0 = <&uart0_default>;

        uart0_default is defined by
        &pinctrl {
          uart0_default: uart0_default {
            group1 {
              pinmux = <GR55XX_PINMUX(PORT_GPIOA, PIN_10, MUX_2, DIGITAL)>, <GR55XX_PINMUX(PORT_GPIOA, PIN_11, MUX_2, DIGITAL)>;
              bias-pull-up;
            };
          };
        };
```

## dts/bindings/trng/goodix,gr5xxx-trng.yaml
```yaml
# Copyright (c) 2024 Goodix
# SPDX-License-Identifier: Apache-2.0

description: |
    Gr5xxx TRNG (True Random Number Generator).

compatible: "goodix,gr5xxx-trng"

include: base.yaml

properties:
  reg:
    required: true
```

## soc/goodix/Kconfig
```kconfig
# Copyright (c) 2024 Goodix
# SPDX-License-Identifier: Apache-2.0

if SOC_FAMILY_GOODIX

rsource "*/Kconfig"

endif
```

## soc/goodix/Kconfig.soc
```kconfig
# Copyright (c) 2024 Goodix
# SPDX-License-Identifier: Apache-2.0

config SOC_SERIES
    default "gr552x" if SOC_SERIES_GR552X

config SOC_FAMILY_GOODIX
    bool

config SOC_FAMILY
    default "goodix" if SOC_FAMILY_GOODIX

config SOC_SERIES_GR552X
    bool
    select SOC_FAMILY_GOODIX
    help
        Enable support for GR5525x SoC

rsource "*/Kconfig.soc"
```

## soc/goodix/gr552x/Kconfig
```kconfig
# Copyright (c) 2024 Goodix
# SPDX-License-Identifier: Apache-2.0

config SOC_SERIES_GR552X
    select ARM
    select CPU_CORTEX_M4
    select USE_DT_CODE_PARTITION
    select REQUIRES_FULL_LIBC
    select CPU_HAS_FPU
    select PLATFORM_SPECIFIC_INIT
    select HAS_SEGGER_RTT
    select CPU_HAS_ARM_MPU
    select FPU
    select HAS_PM
```

## soc/goodix/gr552x/Kconfig.defconfig
```kconfig
# Copyright (c) 2024 Goodix
# SPDX-License-Identifier: Apache-2.0

if SOC_SERIES_GR552X

rsource "Kconfig.defconfig.gr552*"

config SYS_CLOCK_HW_CYCLES_PER_SEC
    default 96000000 if DT_HAS_ARM_ARMV7M_SYSTICK_ENABLED
    default 32768

config SYS_CLOCK_TICKS_PER_SEC
    default 10000 if TICKLESS_KERNEL && DT_HAS_ARM_ARMV7M_SYSTICK_ENABLED
	default 32768 if TICKLESS_KERNEL && !DT_HAS_ARM_ARMV7M_SYSTICK_ENABLED
	default 128  if !TICKLESS_KERNEL && !DT_HAS_ARM_ARMV7M_SYSTICK_ENABLED
	default 100

config PM_NEED_ALL_DEVICES_IDLE
    default y if PM && PM_DEVICE

endif # SOC_SERIES_GR552X
```

## soc/goodix/gr552x/Kconfig.defconfig.gr5525
```kconfig
# Copyright (c) 2024 Goodix
# SPDX-License-Identifier: Apache-2.0

if SOC_GR5525

config NUM_IRQS
    default 66

# Prevent using newlib-nano for maimum compatibility
choice LIBC_IMPLEMENTATION
	default NEWLIB_LIBC
endchoice

config PINCTRL
    default y

config GPIO
    default y

config PWM
    default y

config SERIAL
    default y

config ENTROPY_GENERATOR
    default y

endif # SOC_GR5525
```

## soc/goodix/gr552x/Kconfig.soc
```kconfig
# Copyright (c) 2024 Goodix
# SPDX-License-Identifier: Apache-2.0

config SOC_GR5525
    bool
    select SOC_SERIES_GR552X

config SOC
    default "gr5525" if SOC_GR5525
```

## west.yml
```yaml
# Copyright (c) 2024 Goodix
# SPDX-License-Identifier: Apache-2.0

manifest:
  defaults:
    remote: goodix-ble

  remotes:
    - name: goodix-ble
      url-base: https://github.com/goodix-ble
    - name: zephyrproject-rtos
      url-base: https://github.com/zephyrproject-rtos

  self:
    path: goodix
    west-commands: scripts/west-commands.yml

  projects:
    - name: zephyr
      repo-path: zephyr
      remote: zephyrproject-rtos
      revision: v3.7.0
      import: true

    - name: gr5525_sdk
      repo-path: GR5525.SDK
      remote: goodix-ble
      revision: master
      path: goodix/ble_sdk/gr5525/GR5525.SDK
```
